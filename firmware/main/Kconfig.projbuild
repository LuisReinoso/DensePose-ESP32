## firmware/main/Kconfig.projbuild
```kconfig
menu "DensePose WiFi Configuration"

    config WIFI_SSID
        string "WiFi SSID"
        default "myssid"
        help
            SSID (network name) of the WiFi access point to connect to.
            Set this via: idf.py menuconfig

    config WIFI_PASSWORD
        string "WiFi Password"
        default "mypassword"
        help
            WiFi password (WPA or WPA2) for the access point.
            Set this via: idf.py menuconfig

    config WIFI_MAXIMUM_RETRY
        int "Maximum retry attempts"
        default 5
        help
            Maximum number of times to retry WiFi connection before giving up.

endmenu
```
